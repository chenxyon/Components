## display_driver/Kconfig
```kconfig
menu "Display Driver Configuration"
    depends on FREERTOS

    config DISPLAY_DRIVER_ENABLE
        bool "Enable Display Driver"
        default y
        help
            Enable display driver component.

    config DISPLAY_SPI_MOSI
        int "SPI MOSI pin"
        default 11
        help
            SPI MOSI (Data) pin number.

    config DISPLAY_SPI_MISO
        int "SPI MISO pin"
        default -1
        help
            SPI MISO pin number. Set to -1 if not used.

    config DISPLAY_SPI_SCLK
        int "SPI SCLK pin"
        default 12
        help
            SPI Clock pin number.

    config DISPLAY_SPI_CS
        int "SPI CS pin"
        default 10
        help
            SPI Chip Select pin number.

    config DISPLAY_SPI_DC
        int "SPI DC (Data/Command) pin"
        default 9
        help
            SPI Data/Command pin number.

    config DISPLAY_SPI_RST
        int "SPI RST (Reset) pin"
        default 4
        help
            SPI Reset pin number. Set to -1 if not used.

    config DISPLAY_SPI_BL
        int "SPI Backlight pin"
        default -1
        help
            Backlight control pin number. Set to -1 if not used.

    config DISPLAY_WIDTH
        int "Display width"
        default 320
        help
            Display width in pixels.

    config DISPLAY_HEIGHT
        int "Display height"
        default 240
        help
            Display height in pixels.

    config DISPLAY_SPI_FREQ
        int "SPI frequency (MHz)"
        default 8
        range 1 40
        help
            SPI clock frequency in MHz.

endmenu
```

## font_partition/Kconfig
```kconfig
menu "Font Partition Configuration"
    config FONT_PARTITION_REQUIRED
        bool "Font partition required"
        default y
        help
            Font partition component requires a partition table with sufficient space.
            The GBK font data requires approximately 1.2MB of flash space.
            Make sure the app partition is at least 2MB to accommodate the font data.

            Recommended partition table configuration:
            - Single app large partition (2MB+)
            - Or custom partition table with factory partition >= 2MB

    config FONT_PARTITION_SIZE_MIN
        int "Minimum partition size for fonts (KB)"
        default 2048
        depends on FONT_PARTITION_REQUIRED
        help
            Minimum size in KB for the app partition when using fonts component.
            GBK font data requires approximately 1200KB, so 2048KB (2MB) is recommended.

endmenu
```

## font_service/Kconfig
```kconfig
menu "Font Service Configuration"
    depends on FREERTOS

    config FONT_SERVICE_ENABLE
        bool "Enable Font Service"
        default y
        help
            Enable font service component.

    choice FONT_SERVICE_DEFAULT_FONT
        prompt "Default Font"
        default FONT_SERVICE_DEFAULT_FONT_GBK
        depends on FONT_SERVICE_ENABLE
        help
            Select the default font type.

        config FONT_SERVICE_DEFAULT_FONT_BUILTIN
            bool "Built-in Font (17 chars)"
            help
                Use built-in font with limited characters for testing.

        config FONT_SERVICE_DEFAULT_FONT_GBK
            bool "GBK Full Font (20K chars)"
            help
                Use GBK full font with all Chinese characters.

        config FONT_SERVICE_DEFAULT_FONT_YUESONG
            bool "Yuesong Font (20K chars)"
            help
                Use Yuesong font with all Chinese characters.

        config FONT_SERVICE_DEFAULT_FONT_W25Q
            bool "W25Q128 External Font"
            help
                Use font stored in W25Q128 external flash (reserved for future use).

    endchoice

    config FONT_SERVICE_ENABLE_GBK
        bool "Enable GBK Full Font"
        default y if FONT_SERVICE_DEFAULT_FONT_GBK
        default n
        depends on FONT_SERVICE_ENABLE
        help
            Enable GBK full font support (about 653KB flash).

    config FONT_SERVICE_ENABLE_YUESONG
        bool "Enable Yuesong Font"
        default y if FONT_SERVICE_DEFAULT_FONT_YUESONG
        default n
        depends on FONT_SERVICE_ENABLE
        help
            Enable Yuesong font support (about 653KB flash).

    config FONT_SERVICE_ENABLE_BUILTIN
        bool "Enable Built-in Font"
        default y if FONT_SERVICE_DEFAULT_FONT_BUILTIN
        default y
        depends on FONT_SERVICE_ENABLE
        help
            Enable built-in font support (small, about 340 bytes).

    config FONT_SERVICE_ENABLE_W25Q
        bool "Enable W25Q128 Font"
        default y if FONT_SERVICE_DEFAULT_FONT_W25Q
        default n
        depends on FONT_SERVICE_ENABLE
        help
            Enable W25Q128 external font support (reserved).

endmenu
```

## kws_hub/Kconfig.projbuild
```kconfig
menu "KWS Hub (wake word)"

    choice KWS_ENGINE
        prompt "Wake word engine"
        default KWS_ENGINE_XFYUN_IAT
        help
            讯飞在线听写：唤醒词可任意自定义（改字符串即可），零模型零训练；
            代价是依赖网络，唤醒延迟约 1~2 秒。
            ESP-SR 离线：延迟 <100ms 且不耗流量，但引擎尚未实现，
            且自定义唤醒词需云端训练。

        config KWS_ENGINE_XFYUN_IAT
            bool "XFyun online IAT (text match)"
        config KWS_ENGINE_ESP_SR
            bool "ESP-SR WakeNet (offline, not implemented yet)"
    endchoice

    config KWS_WAKE_WORD
        string "Default wake word"
        default "小智小智"
        help
            默认唤醒词，运行时可用 kws_hub_set_wake_word() 改。
            匹配时忽略空格与标点，所以「小智， 小智」也能命中。

    config KWS_IAT_SAMPLE_RATE
        int "IAT sample rate"
        range 8000 16000
        default 16000

    config KWS_IAT_EOS_MS
        int "End-of-speech silence (ms)"
        range 500 10000
        default 2000
        help
            静音多久判定一句话结束。值越小唤醒越快，但容易把
            说话中间的停顿当成结束。默认 2000。

    config KWS_IAT_DOMAIN
        string "IAT domain"
        default "lm"
        help
            lm = 通用听写模型；slm = 语音听写大模型（需在控制台开通）。

    config KWS_ASR_XFYUN_APPID
        string "IAT APPID (empty = reuse TTS APPID)"
        default ""
        help
            留空则复用语音合成的 APPID。讯飞的应用级密钥对该应用下
            所有服务通用，通常无需单独填。

    config KWS_ASR_XFYUN_API_KEY
        string "IAT API Key (empty = reuse TTS API Key)"
        default ""

    config KWS_ASR_XFYUN_API_SECRET
        string "IAT API Secret (empty = reuse TTS API Secret)"
        default ""

endmenu
```

## system_scheduler/Kconfig
```kconfig
menu "System Scheduler Configuration"
    depends on FREERTOS

    config SCHEDULER_ENABLE
        bool "Enable System Scheduler"
        default y
        help
            Enable system scheduler component.

    config SCHEDULER_MAX_TASKS
        int "Maximum number of scheduled tasks"
        default 10
        depends on SCHEDULER_ENABLE
        help
            Maximum number of tasks that can be registered in the scheduler.

    config SCHEDULER_WATCHDOG_ENABLE
        bool "Enable watchdog integration"
        default n
        depends on SCHEDULER_ENABLE
        help
            Enable watchdog monitoring for scheduled tasks.

endmenu
```

## tts_hub/Kconfig.projbuild
```kconfig
menu "TTS Hub"

    config TTS_XFYUN_APPID
        string "XFyun APPID"
        default ""

    config TTS_XFYUN_API_KEY
        string "XFyun API Key"
        default ""

    config TTS_XFYUN_API_SECRET
        string "XFyun API Secret"
        default ""

    config TTS_XFYUN_SPEED
        int "XFyun speech speed (0-100, default 50, smaller = slower)"
        range 0 100
        default 40

    config TTS_XFYUN_VOLUME
        int "XFyun volume (0-100, default 50)"
        range 0 100
        default 50

endmenu
```

## wifi_manager/Kconfig
```kconfig
menu "WIFI Manager Configuration"

    choice WIFI_CONFIG_MODE
        prompt "Default configuration mode"
        default WIFI_CONFIG_MODE_PHONE
        help
            Select the default method for WIFI configuration.

        config WIFI_CONFIG_MODE_PHONE
            bool "Phone configuration (SoftAP + Web)"
        config WIFI_CONFIG_MODE_SCREEN
            bool "Screen configuration (Reserved)"
    endchoice

    config WIFI_MGR_DEV_MODE
        bool "Development mode: clear WiFi config on every flash"
        default y
        help
            When enabled (development), WiFi SSID/password saved in NVS
            will be erased on every startup, forcing the device into
            configuration portal mode after each firmware flash.

            When disabled (production), existing WiFi credentials are
            preserved across firmware updates; the device connects
            automatically to the previously configured AP.

    config WIFI_MANAGER_MAX_RETRY_COUNT
        int "Maximum retry count"
        default 3
        range 1 100
        help
            Maximum number of retry attempts when WIFI connection fails.

    config WIFI_MANAGER_RETRY_INTERVAL
        int "Retry interval (ms)"
        default 5000
        range 1000 30000
        help
            Interval between retry attempts in milliseconds.

    config WIFI_MANAGER_TIME_SYNC_ENABLED
        bool "Enable time synchronization"
        default y
        help
            Enable automatic time synchronization when WIFI is connected.

    config WIFI_MANAGER_TIME_SYNC_INTERVAL
        int "Time sync interval (minutes)"
        default 60
        range 1 1440
        help
            Time synchronization interval in minutes (1-1440).

    config WIFI_MANAGER_NTP_SERVER
        string "NTP server"
        default "pool.ntp.org"
        help
            NTP server address for time synchronization.

    config WIFI_MANAGER_AUTO_RECONNECT
        bool "Enable auto reconnect"
        default y
        help
            Automatically reconnect when WIFI connection is lost.

    config WIFI_SOFTAP_SSID_PREFIX
        string "SoftAP SSID prefix"
        default "ESP32_Config"
        help
            Prefix for SoftAP SSID.

    config WIFI_SOFTAP_PASSWORD
        string "SoftAP password"
        default "12345678"
        help
            Password for SoftAP. Leave empty for open network.

    config WIFI_SOFTAP_CHANNEL
        int "SoftAP channel"
        default 1
        range 1 13
        help
            WiFi channel for SoftAP.

    config WIFI_SOFTAP_HIDDEN
        bool "Hide SoftAP SSID"
        default n
        help
            Hide the SoftAP SSID from scan results.

    config WIFI_WEBSERVER_PORT
        int "Web server port"
        default 80
        range 1 65535
        help
            Port number for the configuration web server.

endmenu
```
